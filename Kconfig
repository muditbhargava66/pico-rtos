## Kconfig
```kconfig
# Pico-RTOS v0.3.1 Configuration
# This file defines the configuration options for Pico-RTOS using Kconfig syntax

mainmenu "Pico-RTOS v0.3.1 Configuration"

menu "Build Options"

config BUILD_EXAMPLES
    bool "Build example projects"
    default y
    help
      Build the example projects that demonstrate various RTOS features.
      Examples include LED blinking, task synchronization, communication
      patterns, hardware interrupt handling, power management, and
      performance benchmarking.

config BUILD_TESTS
    bool "Build test projects"
    default y
    help
      Build the unit test projects for testing RTOS functionality.
      Tests cover all major RTOS components including tasks, mutexes,
      queues, semaphores, and timers.

config ENABLE_DEBUG
    bool "Enable debug output and assertions"
    default y
    help
      Enable debug output and runtime assertions. This adds debugging
      information and validation checks that help during development
      but may impact performance in production builds.

config ENABLE_INSTALL
    bool "Enable installation targets"
    default n
    help
      Enable CMake installation targets for system-wide installation
      of the RTOS library and headers. Useful for packaging and
      distribution.

endmenu

menu "System Timing"

choice TICK_RATE
    prompt "System tick frequency"
    default TICK_RATE_1000
    help
      Select the system tick frequency in Hz. Higher frequencies provide
      better timing resolution but increase system overhead. Lower
      frequencies reduce overhead but provide coarser timing resolution.

config TICK_RATE_100
    bool "100 Hz (10ms tick)"

config TICK_RATE_250
    bool "250 Hz (4ms tick)"

config TICK_RATE_500
    bool "500 Hz (2ms tick)"

config TICK_RATE_1000
    bool "1000 Hz (1ms tick)"

config TICK_RATE_2000
    bool "2000 Hz (0.5ms tick)"

config TICK_RATE_CUSTOM
    bool "Custom frequency"

endchoice

config TICK_RATE_CUSTOM_VALUE
    int "Custom tick frequency (Hz)"
    depends on TICK_RATE_CUSTOM
    range 10 10000
    default 1000
    help
      Custom system tick frequency in Hz. Must be between 10 and 10000.

config MAX_TASKS
    int "Maximum number of tasks"
    range 1 64
    default 16
    help
      Maximum number of tasks that can be created. Each task consumes
      memory for its control block and stack. Adjust based on your
      application needs and available memory.

config MAX_TIMERS
    int "Maximum number of software timers"
    range 1 32
    default 8
    help
      Maximum number of software timers that can be created. Timers
      are used for delayed execution and periodic callbacks.

config DEFAULT_TASK_STACK_SIZE
    int "Default task stack size (bytes)"
    range 256 8192
    default 1024
    help
      Default stack size for tasks in bytes. Individual tasks can
      override this value. Stack size should be sufficient for the
      task's local variables and function call depth.

config IDLE_TASK_STACK_SIZE
    int "Idle task stack size (bytes)"
    range 128 1024
    default 256
    help
      Stack size for the idle task in bytes. The idle task runs when
      no other tasks are ready and typically has minimal stack
      requirements.

endmenu

menu "v0.3.1 Advanced Synchronization"

config ENABLE_EVENT_GROUPS
    bool "Enable Event Groups"
    default y
    help
      Enable event groups for multi-event synchronization. Event groups
      allow tasks to wait for multiple events simultaneously using
      bit-based synchronization patterns.

config MAX_EVENT_GROUPS
    int "Maximum number of event groups"
    depends on ENABLE_EVENT_GROUPS
    range 1 16
    default 8
    help
      Maximum number of event groups that can be created.

config ENABLE_STREAM_BUFFERS
    bool "Enable Stream Buffers"
    default y
    help
      Enable stream buffers for efficient variable-length message passing.
      Stream buffers provide zero-copy operations for high-performance
      data streaming between tasks.

config MAX_STREAM_BUFFERS
    int "Maximum number of stream buffers"
    depends on ENABLE_STREAM_BUFFERS
    range 1 16
    default 4
    help
      Maximum number of stream buffers that can be created.

config STREAM_BUFFER_ZERO_COPY_THRESHOLD
    int "Zero-copy threshold (bytes)"
    depends on ENABLE_STREAM_BUFFERS
    range 32 1024
    default 128
    help
      Minimum message size for zero-copy operations. Messages larger
      than this threshold will use zero-copy semantics when possible.

endmenu

menu "v0.3.1 Enhanced Memory Management"

config ENABLE_MEMORY_POOLS
    bool "Enable Memory Pools"
    default y
    help
      Enable memory pools for O(1) deterministic memory allocation.
      Memory pools provide fixed-size block allocation with predictable
      performance characteristics.

config MAX_MEMORY_POOLS
    int "Maximum number of memory pools"
    depends on ENABLE_MEMORY_POOLS
    range 1 16
    default 4
    help
      Maximum number of memory pools that can be created.

config MEMORY_POOL_STATISTICS
    bool "Enable memory pool statistics"
    depends on ENABLE_MEMORY_POOLS
    default y
    help
      Enable collection of memory pool usage statistics including
      allocation counts, peak usage, and fragmentation metrics.

config ENABLE_MPU_SUPPORT
    bool "Enable Memory Protection Unit (MPU) support"
    default n
    help
      Enable Memory Protection Unit support for memory protection
      and stack overflow detection. Requires hardware MPU support.

config MPU_STACK_GUARD_SIZE
    int "Stack guard size (bytes)"
    depends on ENABLE_MPU_SUPPORT
    range 32 256
    default 64
    help
      Size of the stack guard region for overflow detection.

endmenu

menu "v0.3.1 Debugging and Profiling"

config ENABLE_TASK_INSPECTION
    bool "Enable runtime task inspection"
    default y
    help
      Enable runtime task state inspection and monitoring. Provides
      APIs to examine task states, stack usage, and execution statistics
      without affecting real-time behavior.

config ENABLE_EXECUTION_PROFILING
    bool "Enable execution time profiling"
    default y
    help
      Enable high-resolution execution time profiling using hardware
      timers. Provides function-level timing analysis with minimal
      overhead.

config PROFILING_BUFFER_SIZE
    int "Profiling buffer size (entries)"
    depends on ENABLE_EXECUTION_PROFILING
    range 16 256
    default 64
    help
      Number of profiling entries to store in the circular buffer.

config ENABLE_SYSTEM_TRACING
    bool "Enable system event tracing"
    default y
    help
      Enable system event tracing with configurable trace buffer.
      Records system events for debugging and analysis.

config TRACE_BUFFER_SIZE
    int "Trace buffer size (events)"
    depends on ENABLE_SYSTEM_TRACING
    range 32 512
    default 128
    help
      Number of trace events to store in the circular buffer.

config ENABLE_ENHANCED_ASSERTIONS
    bool "Enable enhanced assertion handling"
    default y
    help
      Enable enhanced assertion handling with detailed context capture
      and configurable assertion handlers.

endmenu

menu "v0.3.1 Multi-Core Support"

config ENABLE_MULTI_CORE
    bool "Enable multi-core support (SMP)"
    default n
    help
      Enable symmetric multiprocessing (SMP) support for RP2040.
      Allows tasks to run on multiple CPU cores simultaneously.

config ENABLE_LOAD_BALANCING
    bool "Enable load balancing"
    depends on ENABLE_MULTI_CORE
    default y
    help
      Enable automatic load balancing between CPU cores to optimize
      performance and resource utilization.

config LOAD_BALANCE_THRESHOLD
    int "Load balancing threshold (%)"
    depends on ENABLE_LOAD_BALANCING
    range 10 90
    default 75
    help
      CPU utilization threshold for triggering load balancing.

config ENABLE_CORE_AFFINITY
    bool "Enable core affinity"
    depends on ENABLE_MULTI_CORE
    default y
    help
      Enable task binding to specific CPU cores for deterministic
      execution and cache optimization.

config ENABLE_IPC_CHANNELS
    bool "Enable inter-core communication channels"
    depends on ENABLE_MULTI_CORE
    default y
    help
      Enable high-performance inter-core communication using
      hardware FIFOs and shared memory.

config IPC_CHANNEL_BUFFER_SIZE
    int "IPC channel buffer size (messages)"
    depends on ENABLE_IPC_CHANNELS
    range 4 64
    default 16
    help
      Number of messages that can be buffered in each IPC channel.

endmenu

menu "v0.3.1 System Extensions"

config ENABLE_IO_ABSTRACTION
    bool "Enable I/O abstraction layer"
    default n
    help
      Enable thread-safe I/O abstraction layer for unified peripheral
      access with automatic serialization.

config ENABLE_HIRES_TIMERS
    bool "Enable high-resolution timers"
    default n
    help
      Enable microsecond-resolution software timers using RP2040
      hardware timer capabilities with drift compensation.

config HIRES_TIMER_RESOLUTION_US
    int "High-resolution timer resolution (microseconds)"
    depends on ENABLE_HIRES_TIMERS
    range 1 1000
    default 10
    help
      Resolution of high-resolution timers in microseconds.

config ENABLE_UNIVERSAL_TIMEOUTS
    bool "Enable universal timeout support"
    default y
    help
      Enable consistent timeout parameter handling for all blocking
      operations with timeout statistics and monitoring.

endmenu

menu "v0.3.1 Quality Assurance"

config ENABLE_DEADLOCK_DETECTION
    bool "Enable deadlock detection"
    default n
    help
      Enable runtime deadlock detection with resource dependency
      tracking and cycle detection algorithms.

config ENABLE_SYSTEM_HEALTH_MONITORING
    bool "Enable system health monitoring"
    default y
    help
      Enable comprehensive system health monitoring including CPU
      usage tracking, memory monitoring, and health metrics collection.

config HEALTH_CHECK_INTERVAL_MS
    int "Health check interval (milliseconds)"
    depends on ENABLE_SYSTEM_HEALTH_MONITORING
    range 100 10000
    default 1000
    help
      Interval between system health checks in milliseconds.

config ENABLE_WATCHDOG_INTEGRATION
    bool "Enable hardware watchdog integration"
    default y
    help
      Enable hardware watchdog timer integration with automatic
      feeding and timeout recovery mechanisms.

config WATCHDOG_TIMEOUT_MS
    int "Watchdog timeout (milliseconds)"
    depends on ENABLE_WATCHDOG_INTEGRATION
    range 100 30000
    default 5000
    help
      Hardware watchdog timeout in milliseconds.

config ENABLE_ALERT_SYSTEM
    bool "Enable configurable alert system"
    default n
    help
      Enable threshold-based alerting for system metrics with
      callback-based notifications and escalation mechanisms.

endmenu

menu "v0.3.1 Compatibility"

config ENABLE_BACKWARD_COMPATIBILITY
    bool "Enable backward compatibility with v0.2.1"
    default y
    help
      Enable 100% backward compatibility with v0.2.1 APIs.
      Maintains all existing function signatures and behavior.

config ENABLE_MIGRATION_WARNINGS
    bool "Enable migration warnings"
    depends on ENABLE_BACKWARD_COMPATIBILITY
    default y
    help
      Enable compile-time warnings for deprecated APIs with clear
      alternatives and migration paths.

endmenu

menu "Feature Configuration"

config ENABLE_STACK_CHECKING
    bool "Enable stack overflow checking"
    default y
    help
      Enable runtime stack overflow detection. Adds stack canaries
      and periodic stack usage monitoring to detect stack overflows
      before they cause system corruption.

config ENABLE_MEMORY_TRACKING
    bool "Enable memory usage tracking"
    default y
    help
      Enable detailed memory usage tracking including allocation
      statistics, peak usage monitoring, and leak detection.

config ENABLE_RUNTIME_STATS
    bool "Enable runtime statistics collection"
    default y
    help
      Enable collection of runtime statistics including task execution
      times, context switch counts, and system performance metrics.

config ERROR_HISTORY_SIZE
    int "Error history buffer size"
    range 0 50
    default 10
    help
      Number of recent errors to keep in the error history buffer.
      Set to 0 to disable error history tracking.

endmenu

menu "Debug and Logging Configuration"

config ENABLE_DEBUG_LOGGING
    bool "Enable debug logging system"
    default n
    help
      Enable the debug logging system with configurable log levels
      and subsystem filtering. Useful for development and debugging
      but may impact performance in production builds.

choice LOG_LEVEL
    prompt "Default log level"
    depends on ENABLE_DEBUG_LOGGING
    default LOG_LEVEL_INFO
    help
      Select the default log level. Messages below this level
      will be filtered out at compile time.

config LOG_LEVEL_ERROR
    bool "Error only"

config LOG_LEVEL_WARN
    bool "Warning and above"

config LOG_LEVEL_INFO
    bool "Info and above"

config LOG_LEVEL_DEBUG
    bool "Debug and above"

config LOG_LEVEL_VERBOSE
    bool "All messages"

endchoice

config LOG_BUFFER_SIZE
    int "Log buffer size (bytes)"
    depends on ENABLE_DEBUG_LOGGING
    range 256 4096
    default 1024
    help
      Size of the circular log buffer in bytes. Larger buffers
      can hold more log messages but consume more memory.

config ENABLE_LOG_TIMESTAMPS
    bool "Enable log timestamps"
    depends on ENABLE_DEBUG_LOGGING
    default y
    help
      Include timestamps in log messages for better debugging
      and performance analysis.

endmenu
```

## config/defconfig
```kconfig
# Pico-RTOS v0.3.1 Default Configuration
# This file contains the default configuration for Pico-RTOS

# Build Options
CONFIG_BUILD_EXAMPLES=y
CONFIG_BUILD_TESTS=y
CONFIG_ENABLE_DEBUG=y
# CONFIG_ENABLE_INSTALL is not set

# System Timing
CONFIG_TICK_RATE_1000=y
CONFIG_MAX_TASKS=16
CONFIG_MAX_TIMERS=8
CONFIG_DEFAULT_TASK_STACK_SIZE=1024
CONFIG_IDLE_TASK_STACK_SIZE=256

# v0.3.1 Advanced Synchronization
CONFIG_ENABLE_EVENT_GROUPS=y
CONFIG_MAX_EVENT_GROUPS=8
CONFIG_ENABLE_STREAM_BUFFERS=y
CONFIG_MAX_STREAM_BUFFERS=4
CONFIG_STREAM_BUFFER_ZERO_COPY_THRESHOLD=128

# v0.3.1 Enhanced Memory Management
CONFIG_ENABLE_MEMORY_POOLS=y
CONFIG_MAX_MEMORY_POOLS=4
CONFIG_MEMORY_POOL_STATISTICS=y
# CONFIG_ENABLE_MPU_SUPPORT is not set

# v0.3.1 Debugging and Profiling
CONFIG_ENABLE_TASK_INSPECTION=y
CONFIG_ENABLE_EXECUTION_PROFILING=y
CONFIG_PROFILING_BUFFER_SIZE=64
CONFIG_ENABLE_SYSTEM_TRACING=y
CONFIG_TRACE_BUFFER_SIZE=128
CONFIG_ENABLE_ENHANCED_ASSERTIONS=y

# v0.3.1 Multi-Core Support
CONFIG_ENABLE_MULTI_CORE=y
CONFIG_ENABLE_LOAD_BALANCING=y
CONFIG_LOAD_BALANCE_THRESHOLD=75
CONFIG_ENABLE_CORE_AFFINITY=y
CONFIG_ENABLE_IPC_CHANNELS=y
CONFIG_IPC_CHANNEL_BUFFER_SIZE=16

# v0.3.1 System Extensions
# CONFIG_ENABLE_IO_ABSTRACTION is not set
# CONFIG_ENABLE_HIRES_TIMERS is not set
CONFIG_ENABLE_UNIVERSAL_TIMEOUTS=y

# v0.3.1 Quality Assurance
# CONFIG_ENABLE_DEADLOCK_DETECTION is not set
CONFIG_ENABLE_SYSTEM_HEALTH_MONITORING=y
CONFIG_HEALTH_CHECK_INTERVAL_MS=1000
CONFIG_ENABLE_WATCHDOG_INTEGRATION=y
CONFIG_WATCHDOG_TIMEOUT_MS=5000
# CONFIG_ENABLE_ALERT_SYSTEM is not set

# v0.3.1 Compatibility
CONFIG_ENABLE_BACKWARD_COMPATIBILITY=y
CONFIG_ENABLE_MIGRATION_WARNINGS=y

# Feature Configuration
CONFIG_ENABLE_STACK_CHECKING=y
CONFIG_ENABLE_MEMORY_TRACKING=y
CONFIG_ENABLE_RUNTIME_STATS=y
CONFIG_ERROR_HISTORY_SIZE=10

# Debug and Logging Configuration
# CONFIG_ENABLE_DEBUG_LOGGING is not set
```
